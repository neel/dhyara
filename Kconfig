## Kconfig
```kconfig
menu "Dhyara ad hoc network"

    config DHYARA_RECEIVE_QUEUE_SIZE
        int "Receive queue capacity"
        range 20 500
        default 64
        help
            All received packets are initially enqueued in a FreeRTOS queue which is dequeued by another
            FreeRTOS task. This parameter specifies the capacity of that queue.
            
    config DHYARA_SYNC_QUEUE_SIZE
        int "Synchronization queue capacity"
        range 20 256
        default 32
        help
            The neighbourhood synchronization messages are enqueued in a FreeRTOS queue which is dequeued
            by another FreeRTOS task. This parameter specifies the capacity of the synchronization queue
            
    config DHYARA_PEER_CHANNEL
        int "Peer channel"
        range 1 12
        default 1
        help
            The 2.4Ghz WiFi channel which will be used by the nodes participating in the ad-hoc network.
            
    config DHYARA_BROADCAST_CHANNEL
        int "Broadcast channel"
        range 1 12
        default 1
        help
            The 2.4Ghz WiFi channel that is used by the dhyara node to broadcast the beacon at a fixed
            time interval. Note: the other nodes must be able to get the broadcasted beacon.
            
    config DHYARA_BEACON_INTERVAL
        int "Beacon interval (ms)"
        range 10 60000
        default 1000
        help
            Dhyara broadcasts a beacon at a fixed interval to its neighbourhood. This parameter specifies
            the time interval (in micro seconds) of each beacons. 
            
    config DHYARA_DELAY_TOLERANCE
        int "Delay tolerance (us)"
        range 0 5000
        default 0
        help
            Once link quality of a route is changed then the old and the new delays are compared. If the 
            difference between the old and the new delay is higher that the value specified in this parameter  
            then it is considered that the link status has been changed. It is set to 0 by default. However  
            for a large network a too low value like 0 may result into to many unnecessary synchronizations. 
            
            
    config DHYARA_ADVERTISEMENT_EXPIRY
        int "Advertisement expiry (ms)"
        range 10 5000
        default 2000
        help
            Advertisement expiry
            
    config ROUTE_EXPIRY_COEFFICIENT
        int "route expiry time (ms)"
        range 10 2147483647
        default 1000
        help
            If the route is not updated for teh given time period then the route is depreciated.
            
    config DISABLE_SEND_QUEUEING
        bool "Disable queueing of messages that are to be sent"
        default y
        help
            When send queuing is enabled then messages are first queued and the dequeued 
            by a seperate task which actually sends the message. Disabling send queuing
            may improve network throughput while it may lead to frequent ESP_ERR_ESPNOW_NO_MEM
            errors. 

    config MAX_RETRANSMITION_IF_ESPNOW_NO_MEM
        int "maximum number of retries if transmission fails with ESPNOW_NO_MEM"
        default 0
        range 0 10
            help
                Number of retries if transmission fails with ESPNOW_NO_MEM
            
    config ENABLE_MANDATORY_SLEEP_AFTER_TRANSMISSION
        bool "Enable Mandatory Sleep after consecutive transmitions"
        default n
        help
            After N consecutive transmitions there would be a mandatory sleep for specified
            number of microseconds. This sleep is to prevent frequent ESP_ERR_ESPNOW_NO_MEM
            errors when sending too fast. At the same time this mandatory sleep prevents too
            fast communication in the network. So for high speed setup it may be disabled.
            
    config ENABLE_MANDATORY_SLEEP_AFTER_TRANSMISSION_N
        int "Mandatory Sleep after N consecutive transmitions"
        range 1 100
        default 1
        depends on ENABLE_MANDATORY_SLEEP_AFTER_TRANSMISSION
        help
            Applicable only when mandatory sleep is enabled. Number of send instructions after
            which the mandatoru sleep will be performed.
            
    config ENABLE_MANDATORY_SLEEP_AFTER_TRANSMISSION_TIME
        int "Amount of sleep (in ms) after consecutive transmitions"
        range 1 100
        default 1
        depends on ENABLE_MANDATORY_SLEEP_AFTER_TRANSMISSION
        help
            Applicable only when mandatory sleep is enabled. Amount of time in number of micro
            seconds, during which there will be no transmission (e.g. sleep).
            
    config DHYARA_UTIL_UDP_RELAY_BUFFER_SIZE
        int "UDP Relay Buffer Size"
        range 1024 8192
        default 4096
        help
            Buffer size to hold incoming UDP packets while using udp relay
 
    config ENABLE_HTTP_MANAGEMENT_SERVER
        bool "web based management console over HTTP"
        default y
        help
            Enable web based management console over HTTP that can be accessed by http://192.168.4.1 
            after connecting to ESP32 node via wifi. 

    config ENABLE_SERVICES_OVER_HTTP
        bool "HTTP based invocation of services (e.g. ping, routes etc..)"
        default y
        depends on ENABLE_HTTP_MANAGEMENT_SERVER
        help
            Enable HTTP based command invocation

    menu "Selected Services"
        visible if ENABLE_SERVICES_OVER_HTTP

        config ENABLE_SERVICE_ROUTES
            bool "Enable Routes Service"
            depends on ENABLE_SERVICES_OVER_HTTP
            default y
            help 
                Respond with all routes and the best neighbours to reach any node in the known universe

        config ENABLE_SERVICE_UNIVERSE
            bool "Enable Universe Service"
            depends on ENABLE_SERVICES_OVER_HTTP
            default y
            help 
                Respond with all nodes in the known universe

        config ENABLE_SERVICE_PING
            bool "Enable Ping Service"
            depends on ENABLE_SERVICES_OVER_HTTP
            default y
            help 
                Sends ICMP request to an other node via one or more hops

        config ENABLE_SERVICE_PHY_RATE
            bool "Enable Fix Phy Rate Service"
            depends on ENABLE_SERVICES_OVER_HTTP
            default n
            help 
                Set the PHY Rate of a node 

    endmenu 
            
endmenu
```
